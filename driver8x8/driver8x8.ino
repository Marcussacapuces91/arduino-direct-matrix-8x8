/*
  Copyright (c) 2014 par Marc Sibert
 */

// const byte ROW[] = { 8, 5, 10, 4, A3, 11, A5, A0 };
const byte ROW[] = { A0, A5, 11, A3, 4, 10, 5, 8 };

const byte COL[] = { A4, 6, 7, A1, 9, A2, 12, 13 };
// const byte COL[] = { 13, 12, A2, 9, A1, 7, 6, A4 };

// the setup routine runs once when you press reset:
void setup() {

  // for (int i = 0; i < 8; ++i) {
  // pinMode(ROW[i], OUTPUT);
  // digitalWrite(ROW[i], LOW);
  // }
  /*
for (byte i = 0; i < 8; ++i) {
   pinMode(COL[i], OUTPUT);
   digitalWrite(COL[i], LOW);
   }
   */
}



void scan(const byte aScreen[8], const int aDelay = 1000) {

  static const unsigned D = 50;

  const unsigned long time = millis();

  while (millis() - time < aDelay) {

    for (char i = 7; i >= 0; --i) {

      byte mask = 0b01;

      byte n = 0; // compteur de leds allumées
      for (byte j = 0; j < 8; ++j) {
        if (aScreen[i] & mask) {
          pinMode(ROW[j], OUTPUT);
          ++n;
        } 
        else {
          pinMode(ROW[j], INPUT);
        }
        mask *= 2;
      }

      pinMode(COL[i], OUTPUT);
      digitalWrite(COL[i], HIGH);
      delayMicroseconds(n > 4 ? 2 * D : (n < 3 ? D / 2 : D));
      //      delayMicroseconds(n * D);
      digitalWrite(COL[i], LOW);
      pinMode(COL[i], INPUT);
    }


  }
}

/**
 * standard ascii 5x7 font characters,
 * ascii characters 0x20-0x7F (32-127)
 * D'après https://sites.google.com/site/tinymatrix/ By TigerUp
 */
const unsigned char FONT_CHARS[96][5] PROGMEM =
{
  { 0x00, 0x00, 0x00, 0x00, 0x00 },  // (space)
  { 0x00, 0x00, 0x5F, 0x00, 0x00 },  // !
  { 0x00, 0x07, 0x00, 0x07, 0x00 },  // "
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  { 0x08, 0x1C, 0x2A, 0x08, 0x08 }   // <-
};

/////////////////////////////////////////////////////////////////////
//                                   static 5x7 graphics / symbols //
/////////////////////////////////////////////////////////////////////
#define CHARS 15
const unsigned char charset[CHARS][5] PROGMEM =
{
        { 0xFF, 0x41, 0x5D, 0x41, 0xFF },       // psycho 2
        { 0x00, 0x3E, 0x22, 0x3E, 0x00 },       // psycho 1
        { 0x0E, 0x3B, 0x17, 0x3B, 0x0E },       // skull
        { 0x0C, 0x12, 0x24, 0x12, 0x0C },       // heart
        { 0x0A, 0x00, 0x55, 0x00, 0x0A },       // flower
        { 0x08, 0x14, 0x2A, 0x14, 0x08 },       // diamond
        { 0x07, 0x49, 0x71, 0x49, 0x07 },       // cup
        { 0x22, 0x14, 0x6B, 0x14, 0x22 },       // star2
        { 0x36, 0x36, 0x08, 0x36, 0x36 },       // star3
        { 0x06, 0x15, 0x69, 0x15, 0x06 },       // nuke
        { 0x0F, 0x1A, 0x3E, 0x1A, 0x0F },       // fox
        { 0x6C, 0x1A, 0x6F, 0x1A, 0x6C },       // alien
        { 0x7D, 0x5A, 0x1E, 0x5A, 0x7D },       // alien
        { 0x4E, 0x7B, 0x0F, 0x7B, 0x4E },       // alien
        { 0x3D, 0x66, 0x7C, 0x66, 0x3D }        // alien
    //  { 0x, 0x, 0x, 0x, 0x }
};



void print(byte aEcran[], const char aChar, const size_t aPos) {
  for (byte i = 0; i < 5; ++i) {
    aEcran[i + aPos] = pgm_read_byte(&(FONT_CHARS[aChar-32][i]));
  }
}

void loop() {

#if 1
#define LONG 120
  byte E[LONG];
  for (byte i = 0 ; i < LONG; ++i) E[i] = 0;

  print(E, 'A', 8);
  print(E, 'm', 14);
  print(E, 'a', 20);
  print(E, 'n', 26);
  print(E, 'd', 32);
  print(E, 'i', 38);
  print(E, 'n', 44);
  print(E, 'e', 50);

  print(E, '&', 62);
  
  print(E, 'S', 74);
  print(E, 'o', 80);
  print(E, 'l', 86);
  print(E, 'e', 92);
  print(E, 'n', 98);
  print(E, 'n', 104);

  for (byte i = 0; i < LONG - 8; ++i) {
    scan(E + i + 1, 50);
  }
#elif 0

  byte E[50];
  for (byte i = 0 ; i < 50; ++i) E[i] = 0;

  for (byte i = 0; i < 6; ++i) {
    E[i+8] = i < 5 ? S[i] : 0;
    E[i+14] = i < 5 ? o[i] : 0;
    E[i+20] = i < 5 ? l[i] : 0;
    E[i+26] = i < 5 ? e[i] : 0;
    E[i+32] = i < 5 ? n[i] : 0;
    E[i+38] = i < 5 ? n[i] : 0;
  }


  const byte L = 20;
  for (byte i = 0; i < 44; ++i) {
#if 1
    for (byte j = 0 ; j < 10; ++j) {
      scan(E + i, 10-j);
      scan(E + i + 1, j);
    }
#endif
    scan(E + i + 1, 20);

  }
  delay(2000);

#endif
}
